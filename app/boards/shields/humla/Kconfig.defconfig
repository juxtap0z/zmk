## app/boards/shields/humla/Kconfig.defconfig
```kconfig
# Copyright (c) 2023 The ZMK Contributors
# SPDX-License-Identifier: MIT

if SHIELD_HUMLA

config ZMK_KEYBOARD_NAME
    default "Humla"

endif
```

## app/boards/shields/humla/Kconfig.shield
```kconfig
# Copyright (c) 2023 The ZMK Contributors
# SPDX-License-Identifier: MIT

config SHIELD_HUMLA
    def_bool $(shields_list_contains,humla)
```
